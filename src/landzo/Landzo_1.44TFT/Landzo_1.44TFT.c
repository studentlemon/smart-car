#include  "Landzo_1.44TFT.h"

//======================================================
// 128X128液晶底层驱动[8X16]字体库
// 设计者: powerint
// 描  述: [8X16]西文字符的字模数据 (纵向取模,字节倒序)
// !"#$%&'()*+,-./0123456789:;<=>?@ABCDEFGHIJKLMNOPQRSTUVWXYZ[\]^_`abcdefghijklmnopqrstuvwxyz{|}~
//======================================================
const uint8_t Zk_ASCII8X16[][16]=
{
  0x00,0x00,0x00,0x00,0x00,0x00,0x00,0x00,0x00,0x00,0x00,0x00,0x00,0x00,0x00,0x00,//  0
  0x00,0x00,0x00,0xF8,0x00,0x00,0x00,0x00,0x00,0x00,0x00,0x33,0x30,0x00,0x00,0x00,//! 1
  0x00,0x10,0x0C,0x06,0x10,0x0C,0x06,0x00,0x00,0x00,0x00,0x00,0x00,0x00,0x00,0x00,//" 2
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  0x00,0x06,0x01,0x01,0x02,0x02,0x04,0x04,0x00,0x00,0x00,0x00,0x00,0x00,0x00,0x00,//~ 94
  
};

const uint8_t Zk_ASCII6x8[][6] =
{
  { 0x00, 0x00, 0x00, 0x00, 0x00, 0x00 },   // sp
  { 0x00, 0x00, 0x00, 0x2f, 0x00, 0x00 },   // !
  { 0x00, 0x00, 0x07, 0x00, 0x07, 0x00 },   // "
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  { 0x14, 0x14, 0x14, 0x14, 0x14, 0x14 }    // horiz lines
};

/************************************************************************
TFT 一行可以显示16个字符，可以显示8行。
************************************************************************/

#define TFT_SCK  PTE5_OUT
#define TFT_SDA  PTE2_OUT
#define TFT_RST  PTE3_OUT
#define TFT_AO   PTE6_OUT
#define TFT_CS   PTE4_OUT
#define DDRA_SDA DDRE2
#define TFT_SDAI PTE2_INT



/*
4线SPI使用说明：
VBT 供内部DC-DC电压，3.3~4.3V，如果使用5V电压，为保险起见串一个100~500欧的电阻
VCC 供内部逻辑电压 1.8~6V
GND 地



CS  片选管脚
A0  命令数据选择管脚
RES 模块复位管脚
SCK（SCLK） ，时钟脚，由MCU控制
SDA（MOSI） ，主输出从输入数据脚，由MCU控制

*/
/*************************************************************************
*                            北京航空航天大学
*
*  函数名称：TFT_COMDLY
*  功能说明：TFT命令延时
*  参数说明:
*  函数返回：无
*  修改时间：2015-8-20
*  备    注：
*************************************************************************/
void TFT_COMDLY(void){
  vuint16 TFTDlyC ;
  for(TFTDlyC = 0 ;TFTDlyC < 5 ; TFTDlyC++) ;
  
}
/*************************************************************************
*                            北京航空航天大学
*
*  函数名称：TFT_DLY
*  功能说明：TFT延时程序，
*  参数说明:
*  函数返回：无
*  修改时间：2015-8-20
*  备    注：
*************************************************************************/
void TFT_DLY(uint16 ms){
  vuint16 TFTDlyC ,TFTcount;
  uint16 TFTdlay ;
  TFTdlay = ms ;
  for(TFTDlyC = 0 ;TFTDlyC < TFTdlay ; TFTDlyC++) {
    for(TFTcount = 0;TFTcount < 50 ;TFTcount ++); 
  }
  
}
/*************************************************************************
*                            北京航空航天大学
*
*  函数名称：write_command
*  功能说明：TFT命令指令函数
*  参数说明: command   命令
*  函数返回：无
*  修改时间：2015-8-20
*  备    注：
*************************************************************************/
void  write_command(uint8 command){
  vuint8 temp ;
  TFT_CS = 0 ;
  TFT_AO = 0 ;
  TFT_COMDLY() ;
  for(temp = 0 ; temp < 8 ; temp ++){
    TFT_COMDLY() ;
    TFT_SDA = (command)>>7 ;
    TFT_SCK = 0 ;
    asm ("nop"); 
    TFT_SCK = 1 ;
    command <<= 1 ;
  }
  TFT_CS = 1 ;  
  
}
/*************************************************************************
*                            北京航空航天大学
*
*  函数名称：write_data
*  功能说明：TFT写数据函数
*  参数说明: command   命令
*  函数返回：无
*  修改时间：2015-8-20
*  备    注：
*************************************************************************/
void  write_data(uint8 data){
  vuint8 temp ;
  TFT_CS = 0 ;
  TFT_AO = 1 ;
  TFT_COMDLY() ;
  for(temp = 0 ; temp < 8 ; temp ++){
    TFT_COMDLY() ;
    TFT_SDA = (data)>>7 ;
    TFT_SCK = 0 ;
    asm ("nop"); 
    TFT_SCK = 1 ;
    data <<= 1 ;
  }
  TFT_CS = 1 ;  
  
}
/*************************************************************************
*                            北京航空航天大学
*
*  函数名称：read_data
*  功能说明：TFT读数据函数
*  参数说明: command   命令
*  函数返回：无
*  修改时间：2015-8-20
*  备    注：
*************************************************************************/

uint8  read_data(void){
  uint8 temp,data ;
  data = 0 ;
  DDRA_SDA = 0 ;
  TFT_COMDLY() ;
  TFT_CS = 0 ;
  TFT_AO = 1 ;
  TFT_COMDLY() ;
  for(temp = 0 ; temp < 8 ; temp ++){
    TFT_SCK = 1 ;
    TFT_COMDLY() ;
    data |= TFT_SDAI ;
    TFT_COMDLY() ;
    TFT_SCK = 0 ;
    data <<= 1 ;
  }
  TFT_CS = 1 ;  
  DDRA_SDA = 1 ; 
  return data ;
}
/*************************************************************************
*                            北京航空航天大学
*
*  函数名称：TFT_Reset
*  功能说明：TFT复位
*  参数说明:  
*  函数返回：无
*  修改时间：2015-8-20
*  备    注：
*************************************************************************/
void TFT_Reset(void){
    TFT_RST = 0 ;
    TFT_DLY(100) ;
    TFT_RST = 1 ;
    TFT_DLY(100) ;
}
/*************************************************************************
*                            北京航空航天大学
*
*  函数名称：TFT_DataWrite
*  功能说明：TFT复位
*  参数说明:  
*  函数返回：无
*  修改时间：2015-8-20
*  备    注：
*************************************************************************/
void TFT_DataWrite(uint8 DataH,uint8 DataL){
  write_data(DataH) ;
  write_data(DataL) ;
}
/*************************************************************************
*                            北京航空航天大学
*
*  函数名称：dsp_single_colour
*  功能说明：背景颜色设置
*  参数说明:  
*  函数返回：无
*  修改时间：2015-8-20
*  备    注：
*************************************************************************/
void dsp_single_colour(uint8 DISH,uint8 DISL)
{
 uint8 i,j;
 RamAdressSet();
 write_command(0x2C);
 for (i=0;i<128;i++)
    for (j=0;j<128;j++)
        TFT_DataWrite(DISH,DISL);
}
/*************************************************************************
*                            北京航空航天大学
*
*  函数名称: TFT_Claer 
*  功能说明：背景颜色设置
*  参数说明:  
*  函数返回：无
*  修改时间：2015-8-20
*  备    注：
*************************************************************************/
void TFT_Claer(void){
  uint8 i,j;
 RamAdressSet();
 write_command(0x2C);
 for (i=0;i<128;i++)
    for (j=0;j<128;j++)
        TFT_DataWrite(0xff,0xff);
  
}
/*************************************************************************
*                            北京航空航天大学
*
*  函数名称：TFT_Init
*  功能说明：TFT初始化
*  参数说明:  
*  函数返回：无
*  修改时间：2015-8-20
*  备    注：
*************************************************************************/
void TFT_Init(void){
  
      /**************
      PIN初始化
      *************/
  gpio_init (PTE2, GPO,HIGH);
  gpio_init (PTE4, GPO,HIGH);
  gpio_init (PTE5, GPO,HIGH);
  gpio_init (PTE6, GPO,HIGH);
  gpio_init (PTE3, GPO,LOW);

      
      /**************
      TFT初始化
      *************/
      TFT_Reset() ;
     
      write_command(0x11); //Exit Sleep
	TFT_DLY(20);
	write_command(0x26); //Set Default Gamma
	write_data(0x04);
	write_command(0xB1);//Set Frame Rate
	write_data(0x0e);
	write_data(0x10);
	write_command(0xC0); //Set VRH1[4:0] & VC[2:0] for VCI1 & GVDD
	write_data(0x08);
	write_data(0x00);
	write_command(0xC1); //Set BT[2:0] for AVDD & VCL & VGH & VGL
	write_data(0x05);
	write_command(0xC5); //Set VMH[6:0] & VML[6:0] for VOMH & VCOML
	write_data(0x38);
	write_data(0x40);
	
	write_command(0x3a); //Set Color Format
	write_data(0x05);
	write_command(0x36); //RGB
	write_data(0xc8);
	
	write_command(0x2A); //Set Column Address
	write_data(0x00);
	write_data(0x00);
	write_data(0x00);
	write_data(0x7F);
	write_command(0x2B); //Set Page Address
	write_data(0x00);
	write_data(0x00);
	write_data(0x00);
	write_data(0x9F);
	
	write_command(0xB4); 
	write_data(0x00);
	
	write_command(0xf2); //Enable Gamma bit
	write_data(0x01);
	write_command(0xE0); 
	write_data(0x3f);//p1
	write_data(0x22);//p2
	write_data(0x20);//p3
	write_data(0x30);//p4
	write_data(0x29);//p5
	write_data(0x0c);//p6
	write_data(0x4e);//p7
	write_data(0xb7);//p8
	write_data(0x3c);//p9
	write_data(0x19);//p10
	write_data(0x22);//p11
	write_data(0x1e);//p12
	write_data(0x02);//p13
	write_data(0x01);//p14
	write_data(0x00);//p15
	write_command(0xE1); 
	write_data(0x00);//p1
	write_data(0x1b);//p2
	write_data(0x1f);//p3
	write_data(0x0f);//p4
	write_data(0x16);//p5
	write_data(0x13);//p6
	write_data(0x31);//p7
	write_data(0x84);//p8
	write_data(0x43);//p9
	write_data(0x06);//p10
	write_data(0x1d);//p11
	write_data(0x21);//p12
	write_data(0x3d);//p13
	write_data(0x3e);//p14
	write_data(0x3f);//p15
	
	write_command(0x29); // Display On
	write_command(0x2C);
        TFT_Claer();
	  
        
}
/*************************************************************************
*                            北京航空航天大学
*
*  函数名称：RamAdressSet
*  功能说明：RAM地址设置
*  参数说明:
*  函数返回：无
*  修改时间：2015-8-20
*  备    注：
*************************************************************************/
void  RamAdressSet(void)
{
   write_command(0x2A);
   write_data(0x00);
   write_data(0x00);
   write_data(0x00);
   write_data(0x7f);
  
   write_command(0x2B);
   write_data(0x00);
   write_data(0x00);
   write_data(0x00);
   write_data(0x9f);		  
}
/*************************************************************************
*                            北京航空航天大学
*
*  函数名称：PutPixel
*  功能说明：RAM地址设置
*  参数说明: x_start   X方向起始地址，
*            y_start   Y方向起始地址
*            color     颜色
*  函数返回：无
*  修改时间：2015-8-20
*  备    注：
*************************************************************************/

void PutPixel(uint8 x_start,uint8 y_start,uint16 color)
{
	write_data(0x2a);
	write_data(x_start);
	write_data(0x5f);
	write_data(0x2b);
	write_data(y_start+0x34);
	write_data(0x7F);
	write_data(0x2c);
	write_data(color>>8);
	write_data(color&0xff);
	
}

/*************************************************************************
*                            北京航空航天大学
*
*  函数名称：RedLine
*  功能说明：
*  参数说明: 
*  函数返回：无
*  修改时间：2015-8-20
*  备    注：
*************************************************************************/

void RedLine(void)
{
	uint8 i=0,j=0;
	i=66;   // 11格灰阶
	for(j=0;j<16;j++)
	{
		PutPixel(i,j,0xf800);
	}

}

/*************************************************************************
*                            北京航空航天大学
*
*  函数名称：Display_ASCII6X8
*  功能说明：打印6x8的英文字符
*  参数说明: x   X方向起始地址，
*            y   Y方向起始地址
*           ch[]     字符串
*  函数返回：无
*  修改时间：2015-8-20
*  备    注：
*************************************************************************/
void Display_ASCII6X8(uint16 x,uint16 y,uint8 ch[])
{
  uint8_t c=0,i=0,j=0;
  while (ch[j]!='\0')
  {
    c =ch[j]-32;
    if(x>126){x=0;y+=6;}
    
    for(i=0;i<6;i++){
      TFT_Set_Pos(x,y);
      TFT_WrDat(Zk_ASCII6x8[c][i]);      
      y++ ;
    }
    j++;
  }
}
/*************************************************************************
*                            北京航空航天大学
*
*  函数名称：Display_ASCII8X16
*  功能说明：打印8x16的英文字符
*  参数说明: x   X方向起始地址，
*            y   Y方向起始地址
*           ch[]     字符串
*  函数返回：无
*  修改时间：2015-8-20
*  备    注：
*************************************************************************/
void Display_ASCII8X16(uint16 x,uint16 y,uint8 ch[])
{
  uint8_t c=0,i=0,j=0;
  while (ch[j]!='\0')
  {
    c =ch[j]-32;
    if(x>126){x=0;y+=8;}
    
    for(i=0;i<8;i++){
      TFT_Set_Pos(x,y);
      TFT_WrDat(Zk_ASCII8X16[c][i]);
      y++ ;
    }
    x -= 8 ;
    y -= 8 ;
    for(i=0;i<8;i++){
      TFT_Set_Pos(x,y);
      TFT_WrDat(Zk_ASCII8X16[c][i+8]);
      y++ ;
    }
    x += 8 ;
    j++;
  }
	
}
/*************************************************************************
*                            北京航空航天大学
*
*  函数名称：Display_Desc
*  功能说明：显示初始化信息
*  参数说明: 
*  函数返回：无
*  修改时间：2015-8-20
*  备    注：
*************************************************************************/

void Display_Desc(void)
{ 
    Display_ASCII6X8(120,0,"LANDZO0");
    Display_ASCII8X16(20,0,"LANDZO1");
}

/*************************************************************************
*                            北京航空航天大学
*
*  函数名称：TFT_Set_Pos
*  功能说明：设置TFT定位点
*  参数说明: 
*  函数返回：无
*  修改时间：2015-8-20
*  备    注：
*************************************************************************/

 void TFT_Set_Pos(uint8 x,uint8 y)
 {
        write_command(0x2A);  //Column Address Set        ****
	write_data(0);//xsh 
	write_data(x);//xsl 
	write_data(0x00);//xeh 
	write_data(0x7f);//xel 	
	write_command(0x2B);//Row Address Set             ****
	write_data(0);//ysh 
	write_data(y);//ysl
        write_data(0x00);//yeh 
	write_data(0x7f);//yel 
   
 }

/*************************************************************************
*                            北京航空航天大学
*
*  函数名称：TFT_WrDat
*  功能说明：显示
*  参数说明: 
*  函数返回：无
*  修改时间：2015-8-20
*  备    注：
*************************************************************************/
void TFT_WrDat(uint8 data){
    uint8_t i=8;
  
 write_command(0x2c);
	
  while(i--)
  {
    if(data&0x80){
      TFT_DataWrite(DispRGBH,DispRGBL);
    }
    else{
      TFT_DataWrite(BlackRGBH,BlackRGBL);
    }
    data<<=1;
  }
}
/*************************************************************************
*                            北京航空航天大学
*
*  函数名称：TFT_txt
*  功能说明：显示
*  参数说明: 
*  函数返回：无
*  修改时间：2015-8-20
*  备    注：
*************************************************************************/
void TFT_txt(void){
  static uint8 ii ;
         switch(ii)
       {
        case 0: dsp_single_colour(0xff,0xff);//白色
                break;
        case 1: dsp_single_colour(0x00,0x00);//黑色
                break;
        case 2: dsp_single_colour(0xf8,0x00);//红色
                break;
        case 3: dsp_single_colour(0x07,0xe0);//绿色
                break;
        case 4: dsp_single_colour(0x00,0x1f);//蓝色
                break;
        case 5: dsp_single_colour(0xfc,0x07);//棕红色
                break;
        case 6: dsp_single_colour(0xbc,0x40);//棕色
                break;
        case 7: dsp_single_colour(0x01,0xcf);//深蓝色
                break;
        case 8: dsp_single_colour(0x7d,0x7c);//浅蓝色
                break;
       }
       Display_ASCII6X8(20,10,"Landzo"); 
       Display_ASCII6X8(20,30,"TFTLCD TEST");
       Display_ASCII6X8(20,50,"www.landzo.cn");
       ii++;
       if(ii>8) ii = 0;
}